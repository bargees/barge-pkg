## extra/Config.in
```kconfig
source "$BR2_EXTERNAL_BARGE_PKG_PATH/package/bindfs/Config.in"
source "$BR2_EXTERNAL_BARGE_PKG_PATH/package/criu/Config.in"
source "$BR2_EXTERNAL_BARGE_PKG_PATH/package/ipvsadm/Config.in"
source "$BR2_EXTERNAL_BARGE_PKG_PATH/package/locales/Config.in"
source "$BR2_EXTERNAL_BARGE_PKG_PATH/package/shadow/Config.in"
source "$BR2_EXTERNAL_BARGE_PKG_PATH/package/su-exec/Config.in"
```

## extra/package/bindfs/Config.in
```kconfig
config BR2_PACKAGE_BINDFS
	bool "bindfs"
	select BR2_PACKAGE_LIBFUSE
	depends on BR2_TOOLCHAIN_HAS_THREADS
	depends on BR2_USE_MMU
	depends on !BR2_STATIC_LIBS
	help
	  Mount a directory to another location and alter permission bits.

	  http://bindfs.org/

comment "bindfs needs a toolchain w/ threads, dynamic library"
	depends on BR2_USE_MMU
	depends on !BR2_TOOLCHAIN_HAS_THREADS || BR2_STATIC_LIBS
```

## extra/package/criu/Config.in
```kconfig
config BR2_PACKAGE_CRIU
	bool "criu"
	depends on (BR2_arm && BR2_TOOLCHAIN_SUPPORTS_PIE) || BR2_aarch64 \
		|| BR2_i386 || BR2_x86_64 || BR2_powerpc64 || BR2_powerpc64le
	depends on !BR2_ARM_CPU_ARMV4 && !BR2_ARM_CPU_ARMV5
	depends on BR2_TOOLCHAIN_USES_GLIBC
	select BR2_PACKAGE_PROTOBUF_C
	select BR2_PACKAGE_LIBNL
	select BR2_PACKAGE_TAR
	select BR2_PACKAGE_IPROUTE2
	help
	  Checkpoint/Restore In Userspace

	  https://criu.org/

comment "criu needs a glibc toolchain"
	depends on !BR2_TOOLCHAIN_USES_GLIBC
```

## extra/package/ipvsadm/Config.in
```kconfig
config BR2_PACKAGE_IPVSADM
	bool "ipvsadm"
	depends on BR2_TOOLCHAIN_USES_GLIBC
	help
	  Linux Virtual Server administration

	  http://kb.linuxvirtualserver.org/wiki/Ipvsadm
	  https://kernel.org/pub/linux/utils/kernel/ipvsadm/

comment "ipvsadm needs a glibc toolchain"
	depends on !BR2_TOOLCHAIN_USES_GLIBC
```

## extra/package/locales/Config.in
```kconfig
config BR2_PACKAGE_LOCALES
	bool "locales"
	depends on BR2_TOOLCHAIN_USES_GLIBC
	help
	  Common files for locale support

	  https://sourceware.org/glibc/wiki/Locales

comment "locales needs a glibc toolchain"
	depends on !BR2_TOOLCHAIN_USES_GLIBC
```

## extra/package/qemu-ga/Config.in
```kconfig
config BR2_PACKAGE_QEMU_GA
	bool "qemu-ga"
	depends on BR2_TOOLCHAIN_USES_GLIBC
	select BR2_PACKAGE_LIBGLIB2
	help
	  QEMU Guest Agent is a daemon program running inside the domain which is supposed to help management applications with executing functions which need assistance of the guest OS. 

	  https://wiki.qemu.org/Features/GuestAgent

comment "qemu-ga needs a glibc toolchain"
	depends on !BR2_TOOLCHAIN_USES_GLIBC
```

## extra/package/shadow/Config.in
```kconfig
config BR2_PACKAGE_SHADOW
	bool "shadow"
	help
	  The shadow-utils package includes the necessary programs for
	  converting UNIX password files to the shadow password format, plus
	  programs for managing user and group accounts.

	  https://github.com/shadow-maint/shadow
```

## extra/package/singularity/Config.in
```kconfig
config BR2_PACKAGE_SINGULARITY
	bool "singularity"
	depends on BR2_SHARED_STATIC_LIBS
	select BR2_PACKAGE_PYTHON
	select BR2_PACKAGE_PYTHON_BZIP2
	select BR2_PACKAGE_PYTHON_SSL
	select BR2_PACKAGE_PYTHON_ZLIB
	select BR2_PACKAGE_PYTHON_HASHLIB
	select BR2_PACKAGE_CA_CERTIFICATES
	select BR2_PACKAGE_SQUASHFS
	select BR2_PACKAGE_GETENT
	select BR2_PACKAGE_TAR
	select BR2_PACKAGE_LIBCURL
	select BR2_PACKAGE_CURL
	select BR2_PACKAGE_OPENSSL
	select BR2_PACKAGE_FILE
	select BR2_PACKAGE_LIBARCHIVE
	help
	  Application containers for Linux

	  https://github.com/singularityware/singularity

comment "singularity needs both shared and static libraries to build"
	depends on !BR2_SHARED_STATIC_LIBS
```

## extra/package/su-exec/Config.in
```kconfig
config BR2_PACKAGE_SU_EXEC
	bool "su-exec"
	depends on BR2_TOOLCHAIN_USES_GLIBC
	help
	  switch user and group id, setgroups and exec

	  https://github.com/ncopa/su-exec
	  https://github.com/tianon/gosu

comment "su-exec needs an (e)glibc toolchain"
	depends on !BR2_TOOLCHAIN_USES_GLIBC
```
